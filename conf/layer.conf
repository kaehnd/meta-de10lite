## conf/layer.conf
```bitbake
# We have a conf and classes directory, add to BBPATH
BBPATH .= ":${LAYERDIR}"

# We have recipes-* directories, add to BBFILES
BBFILES += "${LAYERDIR}/recipes-*/*/*.bb \
            ${LAYERDIR}/recipes-*/*/*.bbappend"

BBFILE_COLLECTIONS += "meta-de10lite"
BBFILE_PATTERN_meta-de10lite = "^${LAYERDIR}/"
BBFILE_PRIORITY_meta-de10lite = "6"

LAYERDEPENDS_meta-de10lite = "core"
LAYERSERIES_COMPAT_meta-de10lite = "scarthgap"
```

## conf/machine/de10lite.conf
```bitbake
#@TYPE: Machine
#@Name: Altera MAX10 NIOS2 GHRD machine
#@DESCRIPTION: Machine configuration for nios2 machines

require conf/machine/include/tune-nios2.inc

TUNE_FEATURES:append = " hw-div hw-mul"

UBOOT_CONFIG ??= "SPL"
UBOOT_CONFIG[SPL] = "de10lite_config"
UBOOT_BINARY = "u-boot"


UBOOT_ENTRYPOINT = "0xc9000000"
UBOOT_LOADADDRESS = "0xc9000000"

UBOOT_RD_LOADADDRESS = "0xCA800000"
# INITRAMFS_SIZE = "1200"
# INITRAMFS_SIZE = "${@os.stat( d.getVar('DEPLOYDIR')+'/nios2-initramfs-de10lite.cpio.gz').st_size}"
# UBOOT_DTB_LOADADDRESS = "${@  hex(int(d.getVar('UBOOT_RD_LOADADDRESS'), 16) + int(d.getVar('INITRAMFS_SIZE')))}"

INITRAMFS_IMAGE = "nios2-initramfs"
INITRAMFS_IMAGE_BUNDLE = "1"
INITRAMFS_CTYPE ?= "gz"
INITRAMFS_FSTYPES = "cpio.${INITRAMFS_CTYPE}"

# KERNEL_CLASSES:append = " kernel-fitimage"
KERNEL_IMAGETYPE = "vmlinux"
KERNEL_DEVICETREE = "de10lite.dtb"
MACHINE_EXTRA_RRECOMMENDS = "kernel-modules"
MACHINE_FEATURES = "kernel26 serial"

# KBUILD_DEFCONFIG ?= "de10lite_defconfig"

SERIAL_CONSOLES = "115200;ttyJ0"

# no display, no virtual terminals
USE_VT = "0" 

PREFERRED_PROVIDER_virtual/kernel ??= "linux-yocto"
PREFERRED_VERSION_linux-yocto="6.1.14"
PREFERRED_PROVIDER_u-boot ??= "u-boot"

DISTRO_FEATURES="acl debuginfod ext2  pcmcia nfs pci vfat  multiarch vulkan sysvinit gobject-introspection-data ldconfig"
```

## recipes-kernel/linux/linux-yocto/defconfig
```kconfig
CONFIG_LOCALVERSION="-yocto-standard"
CONFIG_SYSVIPC=y
CONFIG_BSD_PROCESS_ACCT=y
CONFIG_LOG_BUF_SHIFT=14
CONFIG_BLK_DEV_INITRD=y
CONFIG_CC_OPTIMIZE_FOR_SIZE=y
CONFIG_NIOS2_MEM_BASE=0x08000000
CONFIG_NIOS2_DTB_SOURCE_BOOL=y
CONFIG_NIOS2_DTB_SOURCE="de10lite.dts"
CONFIG_NIOS2_HW_MUL_SUPPORT=y
CONFIG_NIOS2_HW_DIV_SUPPORT=y
CONFIG_CUSTOM_CACHE_SETTINGS=y
CONFIG_NIOS2_DCACHE_SIZE=0x8000
CONFIG_NIOS2_ICACHE_SIZE=0x8000
# CONFIG_NIOS2_CMDLINE_IGNORE_DTB is not set
CONFIG_MODULES=y
CONFIG_MODULE_UNLOAD=y
CONFIG_DEVTMPFS=y
CONFIG_DEVTMPFS_MOUNT=y
# CONFIG_BLK_DEV is not set
CONFIG_INPUT_FF_MEMLESS=y
# CONFIG_INPUT_MOUSE is not set
# CONFIG_SERIO_SERPORT is not set
CONFIG_SERIAL_8250=y
CONFIG_SERIAL_8250_CONSOLE=y
CONFIG_SERIAL_OF_PLATFORM=y
CONFIG_SERIAL_ALTERA_JTAGUART=y
CONFIG_SERIAL_ALTERA_JTAGUART_CONSOLE=y
CONFIG_SERIAL_ALTERA_UART=y
# CONFIG_HW_RANDOM is not set
CONFIG_PPS=y
CONFIG_GPIOLIB=y
CONFIG_GPIO_ALTERA=y
CONFIG_GPIO_MOCKUP=m
# CONFIG_HWMON is not set
# CONFIG_HID_SUPPORT is not set
# CONFIG_USB_SUPPORT is not set
CONFIG_NEW_LEDS=y
CONFIG_LEDS_CLASS=y
CONFIG_LEDS_GPIO=y
CONFIG_LEDS_TRIGGERS=y
CONFIG_LEDS_TRIGGER_HEARTBEAT=y
# CONFIG_VIRTIO_MENU is not set
# CONFIG_VHOST_MENU is not set
# CONFIG_DNOTIFY is not set
# CONFIG_INOTIFY_USER is not set
# CONFIG_CRYPTO_HW is not set
CONFIG_CRC_T10DIF=m
CONFIG_LIBCRC32C=m
CONFIG_DYNAMIC_DEBUG=y
CONFIG_DEBUG_KERNEL=y
CONFIG_DEBUG_INFO_DWARF_TOOLCHAIN_DEFAULT=y
CONFIG_GDB_SCRIPTS=y
CONFIG_DEBUG_FS=y
CONFIG_KGDB=y
```
